## configs/raspberrypi3_eltakopi_defconfig
```kconfig
BR2_arm=y
BR2_cortex_a7=y
BR2_ARM_FPU_NEON_VFPV4=y
BR2_TOOLCHAIN_BUILDROOT_GLIBC=y
BR2_PACKAGE_HOST_LINUX_HEADERS_CUSTOM_4_9=y
BR2_GLIBC_VERSION_2_23=y
BR2_TOOLCHAIN_BUILDROOT_CXX=y
BR2_PACKAGE_HOST_GDB=y
BR2_TARGET_GENERIC_HOSTNAME="EltakoPI"
BR2_ROOTFS_DEVICE_CREATION_DYNAMIC_EUDEV=y
BR2_TARGET_GENERIC_ROOT_PASSWD="root"
BR2_SYSTEM_DHCP="eth0"
BR2_TARGET_TZ_INFO=y
BR2_ROOTFS_OVERLAY="board/eltakopi/overlay"
BR2_ROOTFS_POST_BUILD_SCRIPT="board/eltakopi/post-build.sh"
BR2_ROOTFS_POST_IMAGE_SCRIPT="board/eltakopi/post-image.sh"
BR2_ROOTFS_POST_SCRIPT_ARGS="--add-pi3-miniuart-bt-overlay"
BR2_LINUX_KERNEL=y
BR2_LINUX_KERNEL_CUSTOM_GIT=y
BR2_LINUX_KERNEL_CUSTOM_REPO_URL="https://github.com/raspberrypi/linux.git"
BR2_LINUX_KERNEL_CUSTOM_REPO_VERSION="935c7ce84c982a26f567a03a58a1537424569938"
BR2_LINUX_KERNEL_DEFCONFIG="bcm2709"
BR2_LINUX_KERNEL_DTS_SUPPORT=y
BR2_LINUX_KERNEL_INTREE_DTS_NAME="bcm2710-rpi-3-b bcm2710-rpi-cm3"
BR2_PACKAGE_GDB=y
BR2_PACKAGE_STRACE=y
BR2_PACKAGE_RPI_FIRMWARE=y
BR2_PACKAGE_SPI_TOOLS=y
BR2_PACKAGE_LIBCURL=y
BR2_PACKAGE_CURL=y
BR2_PACKAGE_DROPBEAR=y
BR2_PACKAGE_DROPBEAR_DISABLE_REVERSEDNS=y
BR2_PACKAGE_ETHTOOL=y
BR2_PACKAGE_IPERF3=y
BR2_PACKAGE_NTP=y
BR2_PACKAGE_NTP_NTPDATE=y
BR2_PACKAGE_NTP_NTPDC=y
BR2_PACKAGE_DOMOTICA_ENGINE=y
BR2_TARGET_ROOTFS_EXT2=y
BR2_TARGET_ROOTFS_EXT2_4=y
BR2_TARGET_ROOTFS_EXT2_BLOCKS=122880
BR2_PACKAGE_HOST_DOSFSTOOLS=y
BR2_PACKAGE_HOST_GENIMAGE=y
BR2_PACKAGE_HOST_MTOOLS=y
```

## package/domotica-engine/Config.in
```kconfig
config BR2_PACKAGE_DOMOTICA_ENGINE
	bool "domotica-engine daemon"
	select BR2_PACKAGE_LIBBUS
	select BR2_PACKAGE_LIBELTAKO
	select BR2_PACKAGE_LIBVSB
	help
	  Domotica engine base daemon
```

## package/libbus/Config.in
```kconfig
config BR2_PACKAGE_LIBBUS
	bool "libbus"
	help
	  Utilitie library for C applications
```

## package/libeltako/Config.in
```kconfig
config BR2_PACKAGE_LIBELTAKO
	bool "libeltako"
	select BR2_PACKAGE_LIBVSB
	help
	  Library to communicate with elktako series 14 domotica system
```

## package/libeu/Config.in
```kconfig
config BR2_PACKAGE_LIBEU
	bool "libeu"
	help
	  Embedded Utilitie library for C applications
```
